## meta-sunxi/recipes-bsp/u-boot/files/v821/v821_defconfig
```kconfig
# V821 production NOR SPL and M-mode recovery proper.
# The base alone builds both flash SPL and RAM-loaded recovery proper.
CONFIG_RISCV=y
# CONFIG_SPL_SYS_DCACHE_OFF is not set
CONFIG_NR_DRAM_BANKS=1
CONFIG_SF_DEFAULT_SPEED=100000000
CONFIG_ENV_SIZE=0x1f000
CONFIG_SPL_DM_SPI=y
CONFIG_DEFAULT_DEVICE_TREE="sun300i-v821-wooboobox-v821b"
CONFIG_SYS_MONITOR_LEN=4194304
CONFIG_SPL_SYS_MALLOC_F_LEN=0x6000
CONFIG_SPL=y
CONFIG_DEBUG_UART_BASE=0x42500000
CONFIG_DEBUG_UART_CLOCK=192000000
CONFIG_DEBUG_UART_BOARD_INIT=y
CONFIG_SPL_SPI_FLASH_SUPPORT=y
# CONFIG_DEBUG_UART is not set
CONFIG_TARGET_WOOBOOBOX_V821B=y
# CONFIG_SPL_SMP is not set
# CONFIG_AVAILABLE_HARTS is not set
CONFIG_BOOTSTD_DEFAULTS=y
CONFIG_SYS_PBSIZE=1050
CONFIG_SPL_PAD_TO=0xb000
CONFIG_EGON_MAX_SIZE=0xb000
CONFIG_SPL_SYS_MALLOC_SIMPLE=y
# CONFIG_SPL_SHARES_INIT_SP_ADDR is not set
# CONFIG_SPL_CPU is not set
CONFIG_SPL_DM_SPI_FLASH=y
CONFIG_SYS_PROMPT="wooboobox-v821b => "
# CONFIG_CMD_UFETCH is not set
# CONFIG_CMD_GPIO is not set
# CONFIG_CMD_MTD is not set
CONFIG_CMD_SPI=y
# CONFIG_ENV_REDUNDANT is not set
CONFIG_SPL_CLK=y
# CONFIG_MMC is not set
# CONFIG_SPL_DM_MMC is not set
# CONFIG_DM_MTD is not set
CONFIG_SPI_FLASH_GIGADEVICE=y
CONFIG_SPI_FLASH_MACRONIX=y
CONFIG_SPI_FLASH_PUYA=y
CONFIG_SPI_FLASH_STMICRO=y
CONFIG_SPI_FLASH_WINBOND=y
CONFIG_SPI_FLASH_XMC=y
CONFIG_SPI_FLASH_XTX=y
CONFIG_SPI_FLASH_ZBIT=y
# CONFIG_SPL_SPI_FLASH_GIGADEVICE is not set
# CONFIG_SPL_SPI_FLASH_MACRONIX is not set
# CONFIG_SPL_SPI_FLASH_PUYA is not set
# CONFIG_SPL_SPI_FLASH_STMICRO is not set
# CONFIG_SPL_SPI_FLASH_WINBOND is not set
# CONFIG_SPL_SPI_FLASH_XMC is not set
# CONFIG_SPI_FLASH_MTD is not set
CONFIG_PINCTRL=y
# CONFIG_SPL_PINCTRL is not set
CONFIG_DEBUG_UART_SHIFT=2
CONFIG_DEBUG_UART_ANNOUNCE=y
CONFIG_SYS_NS16550=y
CONFIG_SPI=y
CONFIG_SPI_SUNXI_SPIF=y
CONFIG_TIMER_EARLY=y
CONFIG_SPL_GZIP=y
CONFIG_DRAM_SUNXI_V821_HOSC_MHZ=40
CONFIG_DRAM_CLK=520
CONFIG_DRAM_ZQ=8092665
CONFIG_SUNXI_DRAM_TYPE_DDR2=y
CONFIG_DRAM_SUNXI_ODT_EN=0x0
CONFIG_DRAM_SUNXI_PARA1=0xd2
CONFIG_DRAM_SUNXI_PARA2=0x400000
CONFIG_DRAM_SUNXI_MR0=0xe73
CONFIG_DRAM_SUNXI_MR1=0x2
CONFIG_DRAM_SUNXI_MR2=0x0
CONFIG_DRAM_SUNXI_TPR0=0x469991
CONFIG_DRAM_SUNXI_TPR1=0x131a10c
CONFIG_DRAM_SUNXI_TPR2=0x56040
CONFIG_DRAM_SUNXI_TPR3=0xb4787896
CONFIG_DRAM_SUNXI_TPR4=0x0
CONFIG_DRAM_SUNXI_TPR7=0x1621121e
CONFIG_DRAM_SUNXI_TPR11=0x0
CONFIG_DRAM_SUNXI_TPR12=0x0
CONFIG_DRAM_SUNXI_TPR13=0xb4006101
CONFIG_SYS_MEM_TOP_HIDE=0x40000
CONFIG_BOOTM_OPENSBI=y
CONFIG_BOOTM_OPENSBI_SCRATCH_OPTIONS=0x1
CONFIG_FIT=y
CONFIG_FIT_EXTERNAL_OFFSET=0x0
# CONFIG_FIT_FULL_CHECK is not set
# CONFIG_FIT_SIGNATURE is not set
# CONFIG_FIT_CIPHER is not set
# CONFIG_FIT_VERBOSE is not set
# CONFIG_FIT_BEST_MATCH is not set
CONFIG_FIT_PRINT=y
CONFIG_SPL_FIT=y
CONFIG_SPL_LOAD_FIT=y
# CONFIG_BOOTSTD is not set
CONFIG_BOOTDELAY=-2
CONFIG_USE_BOOTCOMMAND=y
CONFIG_BOOTCOMMAND="bootm 0x81000000"
CONFIG_BOARD_EARLY_INIT_F=y
# CONFIG_UPDATE_TFTP is not set
# CONFIG_BOOTM_EFI is not set
# CONFIG_DOS_PARTITION is not set
# CONFIG_BINMAN_FDT is not set
# CONFIG_MD5_LEGACY is not set
# CONFIG_SPL_SERIAL is not set
CONFIG_SPL_STACK_R_ADDR=0x83f00000
CONFIG_SPL_STACK_R=y
CONFIG_SPL_STACK_R_MALLOC_SIMPLE_LEN=0x100000
CONFIG_SYS_LOAD_ADDR=0x80800000
CONFIG_SPL_OPENSBI_LOAD_ADDR=0x80fc0000
CONFIG_SPL_MAX_SIZE=0xafa0
CONFIG_SPL_SPI=y
CONFIG_SPL_SPI_FLASH_TINY=y
CONFIG_SPL_SPI_LOAD=y
CONFIG_SPL_SPI_SUNXI_SPIF=y
CONFIG_SPI_MEM=y
CONFIG_SYS_SPI_U_BOOT_OFFS=0x40000
CONFIG_SBI=y
# CONFIG_SBI_V01 is not set
CONFIG_SBI_V02=y
CONFIG_SPL_LOAD_FIT_OPENSBI_OS_BOOT=y
CONFIG_LTO=y
# CONFIG_ENV_VARS_UBOOT_CONFIG is not set
# CONFIG_EFI_LOADER is not set
# CONFIG_SPL_FIT_PRINT is not set
# CONFIG_SPL_FIT_FULL_CHECK is not set
CONFIG_SPL_FIT_HASH_VERIFY=y
CONFIG_SPL_RAM_DEVICE=y
CONFIG_SPL_HAS_LOAD_FIT_ADDRESS=y
CONFIG_SPL_LOAD_FIT_ADDRESS=0x81000000
# CONFIG_SPL_LOAD_FIT_APPLY_OVERLAY is not set
# CONFIG_SPL_LOAD_FIT_FULL is not set
# CONFIG_SPL_FIT_IMAGE_POST_PROCESS is not set
# CONFIG_SUPPORT_RAW_INITRD is not set
# CONFIG_LAST_STAGE_INIT is not set
CONFIG_SPL_HASH=y
# CONFIG_SPL_RAW_IMAGE_SUPPORT is not set
# CONFIG_SPL_LEGACY_IMAGE_FORMAT is not set
# CONFIG_SPL_BANNER_PRINT is not set
# CONFIG_SPL_FIT_IMAGE_TINY is not set
CONFIG_SPL_OS_BOOT_ARGS=y
# DTB comes from FIT; the separate Falcon SPI args payload is unused.
CONFIG_SYS_SPI_ARGS_OFFS=0x0
CONFIG_SYS_SPI_ARGS_SIZE=0x0
CONFIG_SPL_PAYLOAD_ARGS_ADDR=0x80f00000
CONFIG_SPL_OPENSBI=y
CONFIG_SPL_OPENSBI_SCRATCH_OPTIONS=0x1
# CONFIG_CMD_SBI is not set
# CONFIG_CMD_EXT2 is not set
# CONFIG_CMD_EXT4 is not set
# CONFIG_CMD_FAT is not set
# CONFIG_CMD_FS_GENERIC is not set
# CONFIG_SPL_DOS_PARTITION is not set
# CONFIG_ISO_PARTITION is not set
# CONFIG_EFI_PARTITION is not set
# CONFIG_SPL_EFI_PARTITION is not set
CONFIG_SPL_OF_CONTROL=y
CONFIG_SPL_CACHE=y
# CONFIG_NET is not set
CONFIG_SPL_DM=y
CONFIG_SPL_OF_LIBFDT=y
# CONFIG_SPL_TIMER is not set
# CONFIG_SPL_CLK is not set
# CONFIG_SPL_MTD_SPI_NAND is not set
# CONFIG_SPL_SYS_NS16550_SERIAL is not set
# CONFIG_SYSRESET_CV1800B is not set
# CONFIG_POWEROFF_GPIO is not set
# CONFIG_SPL_POWEROFF_GPIO is not set
# CONFIG_SYSRESET_GPIO is not set
# CONFIG_SPL_SYSRESET_GPIO is not set
CONFIG_SYSRESET_SBI=y
# CONFIG_SYSRESET_SYSCON is not set
# CONFIG_SYSRESET_WATCHDOG is not set
# CONFIG_SYSRESET_RESETCTL is not set
# CONFIG_SYSRESET_QCOM_PSHOLD is not set
# CONFIG_SYSRESET_QEMU_VIRT_CTRL is not set
# CONFIG_FS_EXT4 is not set
# CONFIG_FS_FAT is not set
# CONFIG_REGEX is not set
CONFIG_SHA256_LEGACY=y
CONFIG_SHA256=y
# CONFIG_SPL_SHA1 is not set
# CONFIG_SPL_SHA256 is not set
# CONFIG_TOOLS_MKEFICAPSULE is not set
CONFIG_SPL_CRC32=y
CONFIG_CMD_SF=y

# CONFIG_SPL_MD5 is not set

# SPL and proper use upstream Andes L2 cache maintenance.
CONFIG_ANDES_L2_CACHE=y

CONFIG_WDT=y
CONFIG_WDT_SUNXI=y
CONFIG_WATCHDOG=y
CONFIG_SPL_WDT=y
CONFIG_SPL_WATCHDOG=y
CONFIG_WATCHDOG_AUTOSTART=y
CONFIG_WATCHDOG_TIMEOUT_MSECS=16000
CONFIG_SPL_OPTIMIZE_INLINING=y

# Generate the CRC table at runtime to keep the DM SPL inside its SRAM budget.
CONFIG_DYNAMIC_CRC_TABLE=y
# Only the SPL DM nodes consume these properties; board setup owns pinmux/clocks.
CONFIG_OF_SPL_REMOVE_PROPS="pinctrl-0 pinctrl-names clocks clock-names interrupt-parent interrupts interrupts-extended resets reset-names model status allwinner,sample-mode allwinner,sample-delay stdout-path spi-tx-bus-width"

# SPL uses board MMIO pinmux and hardware SPI chip-select, without GPIO drivers.
# CONFIG_SPL_GPIO is not set
# CONFIG_SPL_DM_GPIO is not set
# CONFIG_SUNXI_FEL_STASH is not set
```

## meta-sunxi/recipes-bsp/u-boot/files/x1600/x1600_ax1800_defconfig
```kconfig
CONFIG_MIPS=y
CONFIG_ARCH_JZ47XX=y
CONFIG_TARGET_X1600_AX1800=y
CONFIG_CPU_MIPS32_R2=y
CONFIG_SYS_LITTLE_ENDIAN=y
CONFIG_TEXT_BASE=0x83800000
CONFIG_SYS_MALLOC_LEN=0x100000
CONFIG_SYS_LOAD_ADDR=0x81000000
CONFIG_NR_DRAM_BANKS=1
CONFIG_ENV_IS_NOWHERE=y
CONFIG_ENV_SIZE=0x1000
CONFIG_SPL=y
CONFIG_SPL_TEXT_BASE=0x81800000
CONFIG_SPL_MAX_SIZE=0x1afc0
CONFIG_SPL_BSS_START_ADDR=0x81900000
CONFIG_SPL_BSS_MAX_SIZE=0x10000
CONFIG_SPL_FRAMEWORK=y
CONFIG_SPL_LDSCRIPT="arch/mips/mach-jz47xx/x1600/flash-spl.lds"
CONFIG_TPL=y
CONFIG_TPL_TEXT_BASE=0x80001800
CONFIG_TPL_MAX_SIZE=0x4800
CONFIG_TPL_SYS_MALLOC_F_LEN=0x2000
CONFIG_TPL_LDSCRIPT="arch/mips/mach-jz47xx/x1600/usb-tpl.lds"
# CONFIG_SPL_SERIAL is not set
# CONFIG_TPL_SERIAL is not set
CONFIG_TPL_LIBGENERIC_SUPPORT=y
CONFIG_SPL_OPTIMIZE_INLINING=y
CONFIG_TPL_OPTIMIZE_INLINING=y
CONFIG_SKIP_LOWLEVEL_INIT=y
CONFIG_HAS_CUSTOM_SYS_INIT_SP_ADDR=y
CONFIG_CUSTOM_SYS_INIT_SP_ADDR=0x81f00000
CONFIG_SPL_LIBCOMMON_SUPPORT=y
CONFIG_SPL_LIBGENERIC_SUPPORT=y
CONFIG_SPL_SYS_MALLOC_F_LEN=0x80000
CONFIG_SPL_SYS_MALLOC_SIMPLE=y
# CONFIG_SPL_RAM_DEVICE is not set
CONFIG_SPL_LOAD_FIT=y
# CONFIG_SPL_HAS_LOAD_FIT_ADDRESS is not set

CONFIG_SPL_FIT_HASH_VERIFY=y
CONFIG_SHA256=y
CONFIG_SPL_SHA256=y
CONFIG_FIT=y
# CONFIG_FIT_VERBOSE is not set
CONFIG_OF_LIBFDT=y
CONFIG_DEFAULT_DEVICE_TREE="x1600-ax1800"
CONFIG_OF_CONTROL=y
CONFIG_MIPS_BOOT_FDT=y
# CONFIG_MIPS_BOOT_CMDLINE_LEGACY is not set
# CONFIG_MIPS_BOOT_ENV_LEGACY is not set
CONFIG_DM=y
CONFIG_DM_SERIAL=y
# CONFIG_REQUIRE_SERIAL_CONSOLE is not set
CONFIG_SYS_CONSOLE_INFO_QUIET=y
# CONFIG_DISPLAY_CPUINFO is not set
# CONFIG_DISPLAY_BOARDINFO is not set
CONFIG_BOARD_LATE_INIT=y
CONFIG_BOOTDELAY=-2
CONFIG_USE_BOOTCOMMAND=y
CONFIG_BOOTCOMMAND="bootm 0x80800000"
# CONFIG_SPL_RAW_IMAGE_SUPPORT is not set
CONFIG_BOARD_EARLY_INIT_F=y
CONFIG_BOARD_EARLY_INIT_R=y
CONFIG_SYS_NS16550=y
CONFIG_BAUDRATE=115200
# CONFIG_CONSOLE_RECORD is not set
CONFIG_STACK_SIZE=0x10000

CONFIG_X1600_TPL_FLASH=y
CONFIG_TPL_CRC32=y
CONFIG_SPL_OS_BOOT=y
# CONFIG_SPL_OS_BOOT_ARGS is not set
CONFIG_SPL_LEGACY_IMAGE_FORMAT=y
CONFIG_SPL_LEGACY_IMAGE_CRC_CHECK=y
CONFIG_SPL_OF_CONTROL=y
CONFIG_SPL_DM=y
CONFIG_SPI=y
CONFIG_DM_SPI=y
CONFIG_SPI_INGENIC_SFC=y
CONFIG_SPL_SPI=y
CONFIG_SPL_DM_SPI=y
CONFIG_SPI_FLASH=y
CONFIG_DM_SPI_FLASH=y
CONFIG_SPL_DM_SPI_FLASH=y
CONFIG_SPL_SPI_FLASH_SUPPORT=y
CONFIG_SPL_SPI_LOAD=y
CONFIG_MTD=y
CONFIG_SPI_FLASH_ZBIT=y
CONFIG_SPL_SPI_FLASH_ZBIT=y
CONFIG_SYS_SPI_KERNEL_OFFS=0x20000
CONFIG_SYS_SPI_U_BOOT_OFFS=0x20000
CONFIG_SF_DEFAULT_SPEED=70000000
CONFIG_SF_DEFAULT_MODE=0x2000
CONFIG_SPL_LOAD_FIT_ADDRESS=0x80800000
# CONFIG_USE_BOOTARGS is not set

CONFIG_CLK=y
CONFIG_CLK_INGENIC_X1600=y
CONFIG_PINCTRL=y
CONFIG_PINCTRL_INGENIC_X1600=y
CONFIG_SPL_CLK=y
CONFIG_SPL_PINCTRL=y
# CONFIG_SPL_SPI_FLASH_TINY is not set
CONFIG_SPI_FLASH_GIGADEVICE=y
CONFIG_SPL_SPI_FLASH_GIGADEVICE=y
CONFIG_SPI_FLASH_MACRONIX=y
CONFIG_SPL_SPI_FLASH_MACRONIX=y
CONFIG_SPI_FLASH_PUYA=y
CONFIG_SPL_SPI_FLASH_PUYA=y
CONFIG_SPI_FLASH_STMICRO=y
CONFIG_SPL_SPI_FLASH_STMICRO=y
CONFIG_SPI_FLASH_WINBOND=y
CONFIG_SPL_SPI_FLASH_WINBOND=y
CONFIG_SPI_FLASH_XMC=y
CONFIG_SPL_SPI_FLASH_XMC=y
CONFIG_SPI_FLASH_XTX=y
CONFIG_SPL_SPI_FLASH_XTX=y

CONFIG_WDT=y
CONFIG_WDT_INGENIC_X1600=y
# CONFIG_WATCHDOG is not set
# CONFIG_WATCHDOG_AUTOSTART is not set
# CONFIG_MIPS_CACHE_SETUP is not set
# CONFIG_MIPS_CACHE_DISABLE is not set
CONFIG_SPL_WDT=y

CONFIG_DYNAMIC_CRC_TABLE=y
CONFIG_TPL_TINY_MEMSET=y
```
