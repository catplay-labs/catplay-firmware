## meta-carlinkit-mini/conf/machine/include/clk-mini-ultra/flash-nor.conf
```bitbake
# Flash layout
# Keep in sync with the kernel DTS and X1600 bootloader layout.
C2A_FLASH_SIZE = "16M" 

FLASH_UBOOT_BIN = "${DEPLOY_DIR_IMAGE}/${MACHINE}-u-boot-flash.bin"
FLASH_KERNEL_BIN = "${DEPLOY_DIR_IMAGE}/fitImage"
FLASH_INITRD_BIN = "${DEPLOY_DIR_IMAGE}/${C2A_INITRAMFS_IMAGE}-${MACHINE}.erofs-lz4hc"
FLASH_PERSIST_BIN = "${IMGDEPLOYDIR}/${IMAGE_LINK_NAME}.${C2A_ROOTFS_FSTYPE}"

C2A_FLASH_PARTITIONS = "\
    ${FLASH_UBOOT_BIN} 0x00000000 0x00020000 \
    ${FLASH_KERNEL_BIN} 0x00020000 0x00380000 \
    ${FLASH_INITRD_BIN} 0x003a0000 0x00b80000 \
    ${FLASH_PERSIST_BIN} 0x00f20000 0x000E0000 \
"
```

## meta-carlinkit-mini/conf/machine/include/clk-mini-ultra/recovery.conf
```bitbake
C2A_KERNEL_EXTRA_CONFIG[CONFIG_BLK_DEV_RAM] = "y"
C2A_KERNEL_EXTRA_CONFIG[CONFIG_BLK_DEV_INITRD] = "y"
C2A_KERNEL_EXTRA_CONFIG[CONFIG_BLK_DEV_RAM_COUNT] = "16"
C2A_KERNEL_EXTRA_CONFIG[CONFIG_BLK_DEV_RAM_SIZE] = "16384"

C2A_KERNEL_EXTRA_CONFIG[CONFIG_EARLY_PRINTK] = "y"
C2A_KERNEL_EXTRA_CONFIG[CONFIG_EARLY_PRINTK_8250] = "y"
C2A_KERNEL_EXTRA_CONFIG[CONFIG_EARLY_CONSOLE] = "y"
C2A_KERNEL_EXTRA_CONFIG[CONFIG_USE_GENERIC_EARLY_PRINTK_8250] = "y"
```

## meta-carlinkit-mini/conf/machine/include/clk-mini-ultra/shared.conf
```bitbake
DEFAULTTUNE = "mips32r2el"
MACHINEOVERRIDES =. "clk-mini-ultra:ingenic-x1600:"
PACKAGE_EXTRA_ARCHS:append = " ingenic-x1600"

MACHINE_FEATURES += "wifi bluetooth"

LDFLAGS:append:pn-dropbear:mipsarch = " -static"
PREFERRED_PROVIDER_virtual/bootloader = "u-boot"
UBOOT_MACHINE = "x1600_ax1800_defconfig"

MACHINE_FIRMWARE:append = " carlinkit-otalib aic8800 carlinkit-init carlinkit-mini-nvram aic8800-fw-aic8800d80"
CATPLAY_DEBUG_BUILD ?= "0"

DISTRO = "c2a-musl"
JFFS2_ERASEBLOCK = "0x1000"

#C2A_SYSTEM_PACKAGES:remove = "wpa-supplicant"

include conf/machine/include/mips/tune-mips32r2.inc
include conf/machine/include/clk-mini-ultra/kernel.conf
include conf/machine/include/clk-mini-ultra/wic.conf
```

## meta-carlinkit-mini/conf/machine/x1600-aic8800d80-recov.conf
```bitbake
require conf/machine/include/clk-mini-ultra/shared.conf
require conf/machine/include/clk-mini-ultra/flash-nor.conf
require conf/machine/include/clk-mini-ultra/recovery.conf

require conf/system/include/c2a/machine-boot/fit-erofs.conf

KERNEL_IMAGETYPE = "vmlinuz.bin"
KERNEL_IMAGETYPES = "vmlinuz.bin"
UBOOT_ARCH = "mips"
UBOOT_LOADADDRESS = "0x82f00000"
UBOOT_ENTRYPOINT = "0x82f00000"
UBOOT_RD_LOADADDRESS = "0x82000000"
#require conf/system/include/c2a/machine-boot/initramfs.conf

# catplay-bench
MACHINE_FIRMWARE:append = " i2c-tools devmem2 catplay-g-iphone"
C2A_FLASH_PARTITIONS = ""
C2A_BUNDLE_NAME = "x1600-aic8800d80"
C2A_BUNDLE_EXTRA_DEPENDS:append = " carlinkit-mini-flasher:do_deploy u-boot:do_deploy"

C2A_BUNDLE_ARTIFACTS:append = " \
 ${DEPLOY_DIR_IMAGE}/${MACHINE}-u-boot-tpl.bin,${MACHINE}-u-boot-tpl.bin,1 \
 ${DEPLOY_DIR_IMAGE}/${MACHINE}-u-boot-proper.bin,${MACHINE}-u-boot-proper.bin,1 \
 ${DEPLOY_DIR_IMAGE}/${MACHINE}-u-boot-staging-proper.bin,${MACHINE}-u-boot-staging-proper.bin,1 \
 ${DEPLOY_DIR_IMAGE}/${MACHINE}-u-boot-flash-tpl.bin,${MACHINE}-u-boot-flash-tpl.bin,1 \
 ${DEPLOY_DIR_IMAGE}/${MACHINE}-u-boot-flash-spl.uImage,${MACHINE}-u-boot-flash-spl.uImage,1 \
 ${DEPLOY_DIR_IMAGE}/${MACHINE}-u-boot-flash.bin,${MACHINE}-u-boot-flash.bin,1 \
 ${DEPLOY_DIR_IMAGE}/tools/recovery_fit.py,tools/recovery_fit.py,1 \
"
C2A_BUNDLE_ARTIFACTS:append = " \
 ${DEPLOY_DIR_IMAGE}/tools/errors.py,tools/errors.py,1 \
 ${DEPLOY_DIR_IMAGE}/tools/flash.py,tools/flash.py,1 \
 ${DEPLOY_DIR_IMAGE}/tools/reboot2recovery.py,tools/reboot2recovery.py,1 \
 ${DEPLOY_DIR_IMAGE}/tools/recov.py,tools/recov.py,1 \
 ${DEPLOY_DIR_IMAGE}/tools/wizard.py,tools/wizard.py,1 \
 ${DEPLOY_DIR_IMAGE}/tools/uploader.py,tools/uploader.py,1 \
"

MACHINEOVERRIDES =. "x1600-aic8800d80:"

C2A_APPEND = "init=/usr/bin/carlinkit_otalib root=/dev/initrd mem=64M@0x0 console=ttyS2,3000000n8 rootfstype=erofs rw lpj=549888 driver_async_probe=dwc2,jz4740-mmc c2a_boot=recovery"
```

## meta-carlinkit-mini/conf/machine/x1600-aic8800d80.conf
```bitbake
require conf/machine/include/clk-mini-ultra/shared.conf
require conf/machine/include/clk-mini-ultra/flash-nor.conf

require conf/system/include/c2a/machine-boot/fit-erofs-light.conf

KERNEL_IMAGETYPE = "vmlinuz.bin"
KERNEL_IMAGETYPES = "vmlinuz.bin"
UBOOT_ARCH = "mips"
UBOOT_LOADADDRESS = "0x82f00000"
UBOOT_ENTRYPOINT = "0x82f00000"

# catplay-bench
MACHINE_FIRMWARE:append = " catplay-g-iphone catplay "

C2A_APPEND = "init=/usr/bin/carlinkit_otalib norandmaps slub_max_order=0 slub_min_objects=4 mem=64M@0x0 console=ttyS2,3000000n8 root=/dev/mtdblock_bbt_ro2 rootfstype=erofs rw quiet driver_async_probe=dwc2,jz4740-mmc lpj=549888"
```

## meta-sunxi/conf/machine/include/v821/flash-nor.conf
```bitbake
# Flash layout
# Keep these offsets in sync with the machine DTB partitions.
C2A_FLASH_SIZE = "16M" 

FLASH_BOOT0_BIN = "${DEPLOY_DIR_IMAGE}/${MACHINE}-u-boot-spl.egon.bin"
FLASH_KERNEL_BIN = "${DEPLOY_DIR_IMAGE}/fitImage"
FLASH_INITRD_BIN = "${DEPLOY_DIR_IMAGE}/${C2A_INITRAMFS_IMAGE}-${MACHINE}.erofs-lz4hc"
FLASH_PERSIST_BIN = "${IMGDEPLOYDIR}/${IMAGE_LINK_NAME}.${C2A_ROOTFS_FSTYPE}"

# boot0 256KB
# kernel 4MB
# initrd ~11MB
# persist ~0.75MB

C2A_FLASH_PARTITIONS = "\
    ${FLASH_BOOT0_BIN} 0x00000000 0x00040000 \
    ${FLASH_KERNEL_BIN} 0x00040000 0x00400000 \
    ${FLASH_INITRD_BIN} 0x00440000 0x00b00000 \
    ${FLASH_PERSIST_BIN} 0x00f40000 0x000C0000 \
"
```

## meta-sunxi/conf/machine/include/v821/shared.conf
```bitbake
DEFAULTTUNE = "riscv32"
MACHINEOVERRIDES =. "woo:v821:"

MACHINE_FEATURES += "wifi bluetooth"

LDFLAGS:append:pn-dropbear:mipsarch = " -static"
PREFERRED_PROVIDER_virtual/bootloader = "u-boot"

# Or aic8800-fw-aic8800d80 aic8800
MACHINE_FIRMWARE:append = " carlinkit-otalib carlinkit-init carlinkit-mini-nvram c2a-firmware-rtl8733bs"
CATPLAY_DEBUG_BUILD ?= "0"

DISTRO = "c2a-musl"
JFFS2_ERASEBLOCK = "0x1000"

C2A_SYSTEM_PACKAGES:remove = "wpa-supplicant"

require conf/machine/include/riscv/tune-riscv.inc

include conf/machine/include/v821/kernel.conf
include conf/machine/include/v821/wic.conf

# UPX not compatible with riscv32
IMAGE_UPX_TARGETS:forcevariable = ""
```

## meta-sunxi/conf/machine/v821b-rtl8733bs-recov.conf
```bitbake
require conf/machine/include/v821/shared.conf
require conf/machine/include/v821/flash-nor.conf
require conf/machine/include/v821/recovery.conf

require conf/system/include/c2a/machine-boot/fit-erofs.conf
require conf/machine/include/v821/fit.conf
KERNEL_IMAGETYPE = "Image"
KERNEL_IMAGETYPES = "Image"
C2A_APPEND:append = " console=ttyGS0,115200 init=/usr/bin/carlinkit_otalib c2a_boot=recovery"

# catplay-bench i2c-tools
MACHINE_FIRMWARE:append = " devmem2 "
C2A_FLASH_PARTITIONS = ""
C2A_BUNDLE_NAME = "v821b-rtl8733bs"
C2A_BUNDLE_EXTRA_DEPENDS:append = " sunxi-flasher:do_deploy"
C2A_BUNDLE_EXTRA_DEPENDS:append = " virtual/dtb:do_deploy"
C2A_BUNDLE_EXTRA_DEPENDS:append = " u-boot:do_deploy"
C2A_BUNDLE_EXTRA_DEPENDS:append = " virtual/opensbi:do_deploy"

C2A_BUNDLE_ARTIFACTS:append = " \
 ${DEPLOY_DIR_IMAGE}/${MACHINE}-u-boot-fel.egon.bin,v821b-rtl8733bs-u-boot-fel.egon.bin,1 \
 ${DEPLOY_DIR_IMAGE}/${MACHINE}-u-boot-proper.bin,v821b-rtl8733bs-u-boot-proper.bin,1 \
 ${DEPLOY_DIR_IMAGE}/${MACHINE}-u-boot-spl.egon.bin,v821b-rtl8733bs-u-boot-spl.egon.bin,1 \
 ${DEPLOY_DIR_IMAGE}/${MACHINE}-u-boot-staging.egon.bin,v821b-rtl8733bs-u-boot-staging.egon.bin,1 \
 ${DEPLOY_DIR_IMAGE}/${MACHINE}-u-boot-staging-proper.bin,v821b-rtl8733bs-u-boot-staging-proper.bin,1 \
 ${DEPLOY_DIR_IMAGE}/tools/flash.py,tools/flash.py,1 \
 ${DEPLOY_DIR_IMAGE}/tools/recov.py,tools/recov.py,1 \
 ${DEPLOY_DIR_IMAGE}/tools/uploader.py,tools/uploader.py,1 \
 ${DEPLOY_DIR_IMAGE}/tools/cpbox_client.py,tools/cpbox_client.py,1 \
 ${DEPLOY_DIR_IMAGE}/tools/cpbox2fel.py,tools/cpbox2fel.py,1 \
 ${DEPLOY_DIR_IMAGE}/tools/wizard.py,tools/wizard.py,1 \
 ${DEPLOY_DIR_IMAGE}/tools/reboot2recovery.py,tools/reboot2recovery.py,1 \
"
```

## meta-sunxi/conf/machine/v821b-rtl8733bs.conf
```bitbake
require conf/machine/include/v821/shared.conf
require conf/machine/include/v821/flash-nor.conf

require conf/system/include/c2a/machine-boot/fit-erofs-light.conf
require conf/machine/include/v821/fit.conf
KERNEL_IMAGETYPE = "Image"
KERNEL_IMAGETYPES = "Image"
C2A_APPEND = "c2a_no_ovl console=ttyGS0,115200 root=/dev/mtdblock_bbt_ro2 rootfstype=erofs init=/usr/bin/carlinkit_otalib ro"
#require conf/system/include/c2a/machine-boot/initramfs.conf

# catplay-bench
MACHINE_FIRMWARE:append = " catplay-g-iphone catplay "

C2A_BUNDLE_EXTRA_DEPENDS:append = " u-boot:do_deploy sunxi-flasher:do_deploy virtual/opensbi:do_deploy"
C2A_BUNDLE_ARTIFACTS:append = " \
 ${DEPLOY_DIR_IMAGE}/${MACHINE}-u-boot-fel.egon.bin,${MACHINE}-u-boot-fel.egon.bin,1 \
 ${DEPLOY_DIR_IMAGE}/${MACHINE}-u-boot-spl.egon.bin,${MACHINE}-u-boot-spl.egon.bin,1 \
 ${DEPLOY_DIR_IMAGE}/${MACHINE}-u-boot-proper.bin,${MACHINE}-u-boot-proper.bin,1 \
 ${DEPLOY_DIR_IMAGE}/${MACHINE}-u-boot-staging.egon.bin,${MACHINE}-u-boot-staging.egon.bin,1 \
 ${DEPLOY_DIR_IMAGE}/${MACHINE}-u-boot-staging-proper.bin,${MACHINE}-u-boot-staging-proper.bin,1 \
 ${DEPLOY_DIR_IMAGE}/tools/flash.py,tools/flash.py,1 \
 ${DEPLOY_DIR_IMAGE}/tools/recov.py,tools/recov.py,1 \
 ${DEPLOY_DIR_IMAGE}/tools/uploader.py,tools/uploader.py,1 \
 ${DEPLOY_DIR_IMAGE}/tools/cpbox_client.py,tools/cpbox_client.py,1 \
 ${DEPLOY_DIR_IMAGE}/tools/cpbox2fel.py,tools/cpbox2fel.py,1 \
 ${DEPLOY_DIR_IMAGE}/tools/wizard.py,tools/wizard.py,1 \
 ${DEPLOY_DIR_IMAGE}/tools/reboot2recovery.py,tools/reboot2recovery.py,1 \
"
```
