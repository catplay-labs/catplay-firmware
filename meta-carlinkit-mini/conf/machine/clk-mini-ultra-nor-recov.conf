## meta-carlinkit-mini/conf/machine/clk-mini-ultra-nor-recov.conf
```bitbake
require conf/machine/include/clk-mini-ultra/shared.conf
require conf/machine/include/clk-mini-ultra/flash-nor.conf
require conf/machine/include/clk-mini-ultra/recovery.conf

require conf/system/include/c2a/machine-boot/erofs-base.conf
#require conf/system/include/c2a/machine-boot/initramfs.conf

# catplay-bench
MACHINE_FIRMWARE:append = " i2c-tools devmem2 catplay-g-iphone"
C2A_FLASH_PARTITIONS = ""
C2A_BUNDLE_NAME = "clk-mini-ultra-nor"
C2A_BUNDLE_EXTRA_DEPENDS:append = " carlinkit-mini-flasher:do_deploy"

C2A_BUNDLE_ARTIFACTS:append = " ${DEPLOY_DIR_IMAGE}/ax1800_spi_nor_burner_u-boot-spl.bin,ax1800_spi_nor_burner_u-boot-spl.bin,1"
C2A_BUNDLE_ARTIFACTS:append = " \
 ${DEPLOY_DIR_IMAGE}/tools/errors.py,tools/errors.py,1 \
 ${DEPLOY_DIR_IMAGE}/tools/exploit.py,tools/exploit.py,1 \
 ${DEPLOY_DIR_IMAGE}/tools/flash.py,tools/flash.py,1 \
 ${DEPLOY_DIR_IMAGE}/tools/reboot2recovery.py,tools/reboot2recovery.py,1 \
 ${DEPLOY_DIR_IMAGE}/tools/recov.py,tools/recov.py,1 \
 ${DEPLOY_DIR_IMAGE}/tools/trampoline.py,tools/trampoline.py,1 \
 ${DEPLOY_DIR_IMAGE}/tools/uimage.py,tools/uimage.py,1 \
 ${DEPLOY_DIR_IMAGE}/tools/uploader.py,tools/uploader.py,1 \
"
```

## meta-carlinkit-mini/conf/machine/include/clk-mini-ultra/flash-nor.conf
```bitbake
# Flash layout
# Needs to be in sync with: .dts AND letux-uboot patches
C2A_FLASH_SIZE = "16M" 

FLASH_UBOOT_BIN = "${DEPLOY_DIR_IMAGE}/ax1800_spi_nor_u-boot-spl.bin"
FLASH_KERNEL_BIN = "${DEPLOY_DIR_IMAGE}/${KERNEL_IMAGETYPE}"
FLASH_INITRD_BIN = "${DEPLOY_DIR_IMAGE}/${C2A_INITRAMFS_IMAGE}-${MACHINE}.erofs-lz4hc"
FLASH_PERSIST_BIN = "${IMGDEPLOYDIR}/${IMAGE_LINK_NAME}.${C2A_ROOTFS_FSTYPE}"

C2A_FLASH_PARTITIONS = "\
    ${FLASH_UBOOT_BIN} 0x00000000 0x00020000 \
    ${FLASH_KERNEL_BIN} 0x00020000 0x00380000 \
    ${FLASH_INITRD_BIN} 0x003a0000 0x00b80000 \
    ${FLASH_PERSIST_BIN} 0x00f20000 0x000E0000 \
"
```

## meta-catplay/conf/layer.conf
```bitbake
BBPATH .= ":${LAYERDIR}"
addpylib ${LAYERDIR}/lib catplay_s3
BBFILES += "\
  ${LAYERDIR}/recipes-*/*.bb \
  ${LAYERDIR}/recipes-*/*/*.bb \
  ${LAYERDIR}/recipes-*/*.bbappend \
  ${LAYERDIR}/recipes-*/*/*.bbappend \
"
LICENSE_PATH += "${LAYERDIR}/licenses"

BBFILE_COLLECTIONS += "catplay"
BBFILE_PATTERN_catplay = "^${LAYERDIR}/"
BBFILE_PRIORITY_catplay = "7"

LAYERSERIES_COMPAT_catplay = "scarthgap wrynose"

require conf/catplay/distro-config.conf
```

## meta-sunxi/conf/machine/include/v851s3/bundle/main.conf
```bitbake
C2A_BUNDLE_NAME = "v851s3-aic8800d80"

C2A_BUNDLE_EXTRA_DEPENDS:append = " virtual/dtb:do_deploy virtual/bootloader:do_deploy"

# U-Boot artifacts belong to the regular machine; recovery contributes tools.
C2A_BUNDLE_ARTIFACTS:append = " \
 ${DEPLOY_DIR_IMAGE}/${MACHINE}-u-boot-spl.egon.bin,${MACHINE}-u-boot-spl.egon.bin,1 \
 ${DEPLOY_DIR_IMAGE}/${MACHINE}-u-boot-fel.egon.bin,${MACHINE}-u-boot-fel.egon.bin,1 \
 ${DEPLOY_DIR_IMAGE}/${MACHINE}-u-boot-staging.egon.bin,${MACHINE}-u-boot-staging.egon.bin,1 \
 ${DEPLOY_DIR_IMAGE}/${MACHINE}-u-boot-proper.bin,${MACHINE}-u-boot-proper.bin,1 \
 ${DEPLOY_DIR_IMAGE}/${MACHINE}-u-boot-staging-proper.bin,${MACHINE}-u-boot-staging-proper.bin,1 \
"
```

## meta-sunxi/conf/machine/include/v851s3/bundle/recov.conf
```bitbake
C2A_BUNDLE_NAME = "v851s3-aic8800d80"

C2A_BUNDLE_EXTRA_DEPENDS:append = " sunxi-flasher:do_deploy virtual/dtb:do_deploy"
C2A_BUNDLE_ARTIFACTS:append = " \
 ${DEPLOY_DIR_IMAGE}/tools/flash.py,tools/flash.py,1 \
 ${DEPLOY_DIR_IMAGE}/tools/uploader.py,tools/uploader.py,1 \
 ${DEPLOY_DIR_IMAGE}/tools/cpbox_client.py,tools/cpbox_client.py,1 \
 ${DEPLOY_DIR_IMAGE}/tools/cpbox2fel.py,tools/cpbox2fel.py,1 \
 ${DEPLOY_DIR_IMAGE}/tools/reboot2recovery.py,tools/reboot2recovery.py,1 \
 ${DEPLOY_DIR_IMAGE}/tools/wizard.py,tools/wizard.py,1 \
 ${DEPLOY_DIR_IMAGE}/tools/recov.py,tools/recov.py,1 \
"
```

## meta-sunxi/conf/machine/include/v851s3/flash-nand.conf
```bitbake
require conf/system/include/c2a/machine-boot/fit-erofs-light.conf
require conf/system/include/c2a/persist/ubifs.conf

V851_BOOTLOADER_BIN = "${DEPLOY_DIR_IMAGE}/v851s3-u-boot-spl.egon.bin"
V851_KERNEL_BIN = "${DEPLOY_DIR_IMAGE}/fitImage"
V851_ROOTFS_BIN = "${DEPLOY_DIR_IMAGE}/${C2A_INITRAMFS_IMAGE}-${MACHINE}.erofs-lz4hc"
V851_PERSIST_BIN = "${C2A_WIC_ROOTFS_PATH}"

C2A_OTA_PARTITIONS = "\
    boot0   ${V851_BOOTLOADER_BIN} 0x00100000 \
    kernel  ${V851_KERNEL_BIN}     0x00800000 \
    rootfs  ${V851_ROOTFS_BIN}     0x01000000 \
    persist ${V851_PERSIST_BIN}    0x01000000 \
"
C2A_OTA_METADATA ?= ""
```

## meta-sunxi/conf/machine/include/v851s3/flash-nor.conf
```bitbake
# Not used for now
require conf/system/include/c2a/machine-boot/fit-erofs-light.conf

C2A_FLASH_SIZE_BYTES = "${@16 * 1024 * 1024}"
V851_BOOTLOADER_BIN = "${DEPLOY_DIR_IMAGE}/v851s3-u-boot-spl.egon.bin"
V851_KERNEL_BIN = "${DEPLOY_DIR_IMAGE}/fitImage"
V851_ROOTFS_BIN = "${DEPLOY_DIR_IMAGE}/${C2A_INITRAMFS_IMAGE}-${MACHINE}.erofs-lz4hc"
V851_PERSIST_BIN = "${C2A_WIC_ROOTFS_PATH}"

C2A_FLASH_PARTITIONS = "\
    ${V851_BOOTLOADER_BIN} 0x00000000 0x00100000 \
    ${V851_KERNEL_BIN}     0x00200000 0x00800000 \
    ${V851_ROOTFS_BIN}     0x00a00000 0x01000000 \
    ${V851_PERSIST_BIN}    0x01a00000 0x01000000 \
"
C2A_FLASH_FILL_BYTE = "0xff"
```

## meta-sunxi/conf/machine/include/v851s3/shared.conf
```bitbake
require conf/machine/include/arm/armv7a/tune-cortexa7.inc
require conf/machine/include/v851s3/kernel.conf

MACHINEOVERRIDES =. "v851:v851s3-aic8800d80:v851s:allwinner:"

DISTRO = "c2a-musl"
MACHINE_FEATURES += "wifi bluetooth"
CATPLAY_DEBUG_BUILD ?= "0"
PREFERRED_PROVIDER_virtual/kernel = "linux-sunxi"
PREFERRED_PROVIDER_virtual/dtb = "v851s3-dtb"
PREFERRED_PROVIDER_virtual/bootloader = "u-boot"

MACHINE_FIRMWARE:append = " carlinkit-otalib carlinkit-init carlinkit-mini-nvram aic8800 aic8800-fw-aic8800d80"
C2A_SYSTEM_PACKAGES:remove = "wpa-supplicant"

SRC_URI:append:pn-linux-sunxi = " file://v851s_defconfig"
```

## meta-sunxi/conf/machine/v851s3-aic8800d80-recov.conf
```bitbake
require conf/machine/include/v851s3/shared.conf
require conf/machine/include/v851s3/recovery.conf
require conf/machine/include/v851s3/bundle/recov.conf

C2A_APPEND:append = " console=ttyGS0,115200 init=/usr/bin/carlinkit_otalib"

MACHINEOVERRIDES =. "v851s3-aic8800d80-recov:v851s3-aic8800d80:"
```

## meta-sunxi/conf/machine/v851s3-aic8800d80.conf
```bitbake
require conf/machine/include/v851s3/shared.conf
require conf/machine/include/v851s3/flash-nand.conf
require conf/machine/include/v851s3/bundle/main.conf

C2A_APPEND = "c2a_no_ovl console=ttyGS0,115200 root=/dev/mtdblock_bbt_ro3 rootfstype=erofs init=/usr/bin/carlinkit_otalib ro"

MACHINE_FIRMWARE:append = " catplay-g-iphone catplay "
```

## meta-sunxi/recipes-bsp/u-boot/files/v851s3/v851s_defconfig
```kconfig
CONFIG_ARM=y
CONFIG_ARCH_SUNXI=y
CONFIG_SUPPORT_PASSING_ATAGS=y
CONFIG_CMDLINE_TAG=y
CONFIG_TEXT_BASE=0x46000000
CONFIG_DEFAULT_DEVICE_TREE="sun8i-v851s-wooboobox-t2"
CONFIG_SPL_STACK_R_ADDR=0x47c00000
CONFIG_SPL_TEXT_BASE=0x20060
CONFIG_SPL_BSS_START_ADDR=0x47e00000
CONFIG_SPL_BSS_MAX_SIZE=0x80000
CONFIG_SPL=y
CONFIG_SPL_DM=y
CONFIG_SPL_OF_CONTROL=y
CONFIG_SPL_WDT=y
CONFIG_SPL_WATCHDOG=y
CONFIG_LTO=y
# CONFIG_SPL_SERIAL is not set
# CONFIG_SPL_SERIAL_PRESENT is not set
# CONFIG_SPL_BANNER_PRINT is not set
CONFIG_SPL_MAX_SIZE=0x1dfa0
CONFIG_SPL_SIZE_LIMIT=0x1dfa0
CONFIG_EGON_MAX_SIZE=0x1e000
CONFIG_DRAM_SUNXI_ODT_EN=0x1
CONFIG_DRAM_SUNXI_TPR11=0x00120000
CONFIG_DRAM_SUNXI_TPR12=0x00000057
CONFIG_DRAM_SUNXI_TPR13=0xb4086103
CONFIG_MACH_SUN8I_V851S=y
CONFIG_SUNXI_FEL_RECOVERY=y
CONFIG_DRAM_CLK=936
CONFIG_DRAM_ZQ=8092667
CONFIG_SUNXI_MINIMUM_DRAM_MB=128
# CONFIG_SPL_SPI_SUNXI is not set
CONFIG_SPL_SUNXI_SPI_NAND=y
CONFIG_SPL_SUNXI_DCACHE=y
CONFIG_SPL_SUNXI_SPI_NAND_CLOCK_HZ=100000000
CONFIG_SPL_SUNXI_SPI_NAND_IO_CHUNK=2048
# CONFIG_SPL_SUNXI_SPI_NAND_QUAD is not set
CONFIG_SPL_SUNXI_SPI_NAND_SAMPLING=y
CONFIG_SPL_SUNXI_SPI_NAND_SAMPLE_MODE=1
CONFIG_SPL_SUNXI_SPI_NAND_SAMPLE_DELAY=18
CONFIG_SPL_SUNXI_SPI_NAND_MFR=0xd8
CONFIG_SPL_SUNXI_SPI_NAND_DEVID=0x81
CONFIG_SPL_SUNXI_SPI_NAND_PAGE_SIZE=2048
CONFIG_SPL_SUNXI_SPI_NAND_OOB_SIZE=128
CONFIG_SPL_SUNXI_SPI_NAND_PAGES_PER_BLOCK=64
CONFIG_SPL_SUNXI_SPI_NAND_PAGE_COUNT=65536
# Current test: kernel partition at 0x200000 (physical block 16), 8 MiB.
# Future proper FIT: uboot partition at 0x100000, FIRST_BLOCK=8,
# BLOCK_COUNT=8; keep IMAGE_OFFSET=0 for partition-local bad-block mapping.
CONFIG_SPL_SUNXI_SPI_NAND_FIRST_BLOCK=16
CONFIG_SPL_SUNXI_SPI_NAND_BLOCK_COUNT=64
CONFIG_SPL_SUNXI_SPI_NAND_IMAGE_OFFSET=0x0
CONFIG_SPL_SUNXI_SPI_NAND_ECC_MASK=0x70
CONFIG_SPL_SUNXI_SPI_NAND_ECC_UNCORRECTABLE=0x70
# CONFIG_MMC is not set
CONFIG_FIT=y
# CONFIG_FIT_PRINT is not set
# CONFIG_ZSTD is not set
# CONFIG_OF_LIBFDT_OVERLAY is not set
CONFIG_SYS_BOOTM_LEN=0x01000000
# CONFIG_SYS_MALLOC_CLEAR_ON_INIT is not set
# CONFIG_EFI_LOADER is not set
CONFIG_SPL_FIT=y
CONFIG_SPL_LOAD_FIT=y
CONFIG_SPL_OS_BOOT=y
# CONFIG_SPL_OS_BOOT_ARGS is not set
CONFIG_SPL_GZIP=y
CONFIG_SPL_CRC32=y
CONFIG_SPL_CRC32_SLICING4=y
CONFIG_SPL_FIT_HASH_VERIFY=y
CONFIG_WDT=y
CONFIG_WDT_SUNXI=y
CONFIG_WATCHDOG=y
CONFIG_WATCHDOG_AUTOSTART=y
CONFIG_WATCHDOG_TIMEOUT_MSECS=16000
# CONFIG_BOOTSTD is not set
# CONFIG_DISTRO_DEFAULTS is not set
CONFIG_BOOTDELAY=1
CONFIG_USE_BOOTARGS=y
CONFIG_USE_BOOTCOMMAND=y
CONFIG_BOOTCOMMAND="bootm 0x41000000"
# CONFIG_HUSH_PARSER is not set
# CONFIG_CONSOLE_MUX is not set
CONFIG_LAST_STAGE_INIT=y
# CONFIG_SPL_RAM_DEVICE is not set
# CONFIG_BOOTM_NETBSD is not set
# CONFIG_BOOTM_PLAN9 is not set
# CONFIG_BOOTM_RTEMS is not set
# CONFIG_BOOTM_VXWORKS is not set
# CONFIG_CMD_ELF is not set
# CONFIG_CMD_FDT is not set
# CONFIG_CMD_IMI is not set
# CONFIG_CMD_XIMG is not set
# CONFIG_CMD_EXPORTENV is not set
# CONFIG_CMD_IMPORTENV is not set
# CONFIG_CMD_BIND is not set
# CONFIG_CMD_GPT is not set
CONFIG_CMD_MTD=y
# CONFIG_CMD_BDI is not set
# CONFIG_CMD_BOOTD is not set
# CONFIG_CMD_CONSOLE is not set
# CONFIG_CMD_CRC32 is not set
# CONFIG_CMD_DM is not set
CONFIG_CMD_ECHO=y
# CONFIG_CMD_EDITENV is not set
# CONFIG_CMD_ENV_EXISTS is not set
# CONFIG_CMD_GO is not set
# CONFIG_CMD_HELP is not set
# CONFIG_CMD_ITEST is not set
# CONFIG_CMD_LOADB is not set
# CONFIG_CMD_LOADS is not set
CONFIG_CMD_MEMORY=y
# CONFIG_CMD_PART is not set
# CONFIG_CMD_PINMUX is not set
# CONFIG_CMD_RANDOM is not set
# CONFIG_CMD_RUN is not set
# CONFIG_CMD_SAVEENV is not set
# CONFIG_CMD_SF is not set
CONFIG_CMD_SLEEP=y
# CONFIG_CMD_SOURCE is not set
# CONFIG_CMD_BLOCK_CACHE is not set
CONFIG_ENV_IS_NOWHERE=y
# CONFIG_CMD_SETEXPR is not set
# CONFIG_BOOTP_BOOTPATH is not set
# CONFIG_BOOTP_DNS is not set
# CONFIG_BOOTP_GATEWAY is not set
# CONFIG_BOOTP_HOSTNAME is not set
# CONFIG_BOOTP_SUBNETMASK is not set
# CONFIG_BOOTP_PXE is not set
# CONFIG_CMD_MII is not set
# CONFIG_CMD_CYCLIC is not set
# CONFIG_EFI_PARTITION is not set
# CONFIG_ENV_IS_IN_FAT is not set
# CONFIG_ENV_IS_IN_SPI_FLASH is not set
CONFIG_MTD=y
CONFIG_DM_MTD=y
CONFIG_MTD_SPI_NAND=y
# CONFIG_SPI_FLASH is not set
CONFIG_NO_NET=y
# CONFIG_USB is not set
# CONFIG_CMDLINE_EDITING is not set
# CONFIG_AUTO_COMPLETE is not set
# CONFIG_SYS_LONGHELP is not set
CONFIG_DRAM_SUNXI_PARA2=0x00800000
CONFIG_DRAM_SUNXI_PARA1=0x10d2
CONFIG_DRAM_SUNXI_MR0=0x00001e14
CONFIG_DRAM_SUNXI_MR1=0x42
CONFIG_DRAM_SUNXI_MR2=0x20
CONFIG_DRAM_SUNXI_TPR4=0x1000
CONFIG_DRAM_SUNXI_TPR7=0x1621121e
CONFIG_DRAM_SUNXI_TPR0=0x004899d7
CONFIG_DRAM_SUNXI_TPR1=0x01c241d0
CONFIG_DRAM_SUNXI_TPR2=0x000a4039
CONFIG_DRAM_SUNXI_TPR3=0xb4787896
CONFIG_SPI=y
# CONFIG_SHA256 is not set
# CONFIG_SPL_SHA1 is not set
# CONFIG_LZMA is not set
# CONFIG_SPL_LZMA is not set
```
